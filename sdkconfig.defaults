## sdkconfig.defaults
```kconfig
# newlib for ESP32 and ESP8266 platform

CONFIG_NEWLIB_ENABLE=y
CONFIG_NEWLIB_LIBRARY_LEVEL_NORMAL=y
CONFIG_NEWLIB_NANO_FORMAT=
CONFIG_SSL_USING_MBEDTLS=y
CONFIG_LWIP_IPV6=y

# default client credential
CONFIG_MQTT_CLIENT_IDENTIFIER="test"
CONFIG_MQTT_BROKER_ENDPOINT="a2jl9ndedgotsf-ats.iot.us-west-2.amazonaws.com"
CONFIG_MQTT_BROKER_PORT=8883
```
